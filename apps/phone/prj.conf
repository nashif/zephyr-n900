## CMakeLists.txt
```
cmake_minimum_required(VERSION 3.20.0)
find_package(Zephyr REQUIRED HINTS $ENV{ZEPHYR_BASE})
project(n900_phone)

# Camera sensor register lists are generated from a local Linux tree at build time
set(LINUX_DIR $ENV{HOME}/linux CACHE PATH "Linux source tree with the et8ek8 driver")
set(ET8EK8_MODES ${LINUX_DIR}/drivers/media/i2c/et8ek8/et8ek8_mode.c)
set(GEN_DIR ${CMAKE_CURRENT_BINARY_DIR}/gen)
add_custom_command(
  OUTPUT ${GEN_DIR}/et8ek8_regs.h
  COMMAND ${PYTHON_EXECUTABLE} ${CMAKE_CURRENT_SOURCE_DIR}/gen_regs.py
          ${ET8EK8_MODES} ${GEN_DIR}/et8ek8_regs.h
  DEPENDS ${CMAKE_CURRENT_SOURCE_DIR}/gen_regs.py ${ET8EK8_MODES}
)
add_custom_target(et8ek8_regs DEPENDS ${GEN_DIR}/et8ek8_regs.h)
add_dependencies(app et8ek8_regs)
target_include_directories(app PRIVATE ${GEN_DIR})
# Zephyr kite images from the documentation artwork
set(KITE_PNG $ENV{ZEPHYR_BASE}/doc/_static/images/kite.png)
add_custom_command(
  OUTPUT ${GEN_DIR}/kites.c ${GEN_DIR}/kites.h
  COMMAND ${PYTHON_EXECUTABLE} ${CMAKE_CURRENT_SOURCE_DIR}/gen_kites.py
          ${KITE_PNG} ${GEN_DIR}/kites.c ${GEN_DIR}/kites.h
  DEPENDS ${CMAKE_CURRENT_SOURCE_DIR}/gen_kites.py ${KITE_PNG}
)
add_custom_target(kites DEPENDS ${GEN_DIR}/kites.c ${GEN_DIR}/kites.h)
add_dependencies(app kites)
target_sources(app PRIVATE src/hw.c src/ui.c src/camera.c src/sound.c ${GEN_DIR}/kites.c)
```

## prj.conf
```kconfig
CONFIG_MAIN_STACK_SIZE=16384
CONFIG_SYSTEM_WORKQUEUE_STACK_SIZE=4096
CONFIG_INPUT=y
CONFIG_DISPLAY=y
CONFIG_SENSOR=y
CONFIG_LED=y

CONFIG_LVGL=y
CONFIG_LV_Z_MEM_POOL_SIZE=4194304
CONFIG_LV_Z_VDB_SIZE=25
CONFIG_LV_FONT_MONTSERRAT_14=y
CONFIG_LV_FONT_MONTSERRAT_20=y
CONFIG_LV_FONT_MONTSERRAT_28=y
CONFIG_LV_FONT_MONTSERRAT_48=y
CONFIG_LV_FONT_DEFAULT_MONTSERRAT_20=y
CONFIG_LV_USE_LOG=n
CONFIG_LV_Z_SW_ROTATION=y
CONFIG_GPIO=y
CONFIG_I2C=y
CONFIG_CACHE_MANAGEMENT=y
CONFIG_KERNEL_VM_SIZE=0x2000000
CONFIG_HAPTICS=y
CONFIG_I2S=y
CONFIG_AUDIO=y
CONFIG_AUDIO_CODEC=y
```

## src/camera.c
```c
/*
 * N900 phone demo: main camera. The ET8EK8 sensor streams 648x492 RAW10 over
 * CCP2 into the OMAP3 ISP receiver, whose memory port writes each frame to RAM.
 * A thread turns frames into previews and photos, runs auto exposure, white
 * balance and contrast autofocus with the AD5820 lens actuator, and fires the
 * ADP1653 flash.
 */
#include <math.h>
#include <string.h>
#include <zephyr/cache.h>
#include <zephyr/drivers/gpio.h>
#include <zephyr/drivers/i2c.h>
#include <zephyr/drivers/led.h>
#include <zephyr/drivers/mfd/twl4030.h>
#include <zephyr/kernel.h>
#include <zephyr/sys/sys_io.h>

#include "camera.h"
#include "et8ek8_regs.h"

static const struct device *const i2c3 = DEVICE_DT_GET(DT_NODELABEL(i2c3));
static const struct device *const gpio4 = DEVICE_DT_GET(DT_NODELABEL(gpio4));
static const struct device *const twl = DEVICE_DT_GET(DT_NODELABEL(twl));
static const struct device *const flash = DEVICE_DT_GET(DT_NODELABEL(flash));

/* ADP1653 LEDs */
#define FLASH_LED_INDICATOR 1
#define FLASH_LED_FLASH     2

/* TWL5030 VAUX4: camera analog supply, 2.8 V */
#define VAUX4_DEV_GRP   0x7E
#define VAUX4_DEDICATED 0x81

/* Clock and power management */
#define CM_FCLKEN_CAM    0x48004F00
#define CM_ICLKEN_CAM    0x48004F10
#define CM_CLKSEL_CAM    0x48004F40
#define CM_CLKSTCTRL_CAM 0x48004F48
#define CM_CLKEN_PLL     0x48004D00
#define PWRDN_CAM        BIT(30)
#define PM_PWSTCTRL_CAM  0x48306FE0

/* Pads and PHY routing */
#define PAD_CAM_XCLKA 0x48002110
#define PAD_CAM_D3    0x4800211C
#define PAD_CAM_D6    0x48002122
#define CSIRXFE       0x480022DC

/* ISP and its CCP2 receiver */
#define ISP_BASE           0x480BC000
#define ISP_SYSCONFIG      (ISP_BASE + 0x04)
#define ISP_CTRL           (ISP_BASE + 0x40)
#define ISP_TCTRL          (ISP_BASE + 0x50)
#define CCP2               (ISP_BASE + 0x400)
#define CCP2_SYSCONFIG     (CCP2 + 0x04)
#define CCP2_SYSSTATUS     (CCP2 + 0x08)
#define CCP2_LC01_IRQSTAT  (CCP2 + 0x10)
#define CCP2_CTRL          (CCP2 + 0x40)
#define CCP2_LC0_CTRL      (CCP2 + 0x50)
#define CCP2_LC0_DAT_START (CCP2 + 0x68)
#define CCP2_LC0_DAT_SIZE  (CCP2 + 0x6C)
#define CCP2_LC0_PING      (CCP2 + 0x70)
#define CCP2_LC0_PONG      (CCP2 + 0x74)
#define CCP2_LC0_OFST      (CCP2 + 0x78)
#define LC0_FS             BIT(11)
#define LC0_FE             BIT(8)
#define LC0_ERRORS         0x3FU
#define LC0_FORMAT_RAW10   0x15U

/* Sensor */
#define SENSOR_ADDR  0x3E
#define REG_EXPOSURE 0x1243
#define REG_AGAIN_L  0x1249
#define REG_AGAIN_H  0x124A
#define REG_STREAM   0x1252
#define STREAM_ON    0xB0
#define STREAM_OFF   0x30
#define EXPOSURE_MAX 500U
#define AGAIN_MIN    0x20U
#define AGAIN_MAX    0x100U
#define BLACK_LEVEL  64

/* Lens actuator: 10-bit position at bit 4, bit 15 powers it down */
#define LENS_ADDR  0x0C
#define LENS_SHIFT 4
#define LENS_MAX   1023U

#define RAW_W      648
#define RAW_H      492
#define RAW_STRIDE 656 /* 1312 bytes, a multiple of 32 */
#define CELLS_W    (RAW_W / 2)
#define CELLS_H    (RAW_H / 2)

static uint16_t raw[RAW_H][RAW_STRIDE] __aligned(64);
static uint32_t cells[CELLS_H][CELLS_W];
static uint32_t previews[3][CAM_PREVIEW_W * CAM_PREVIEW_H];
static uint32_t photos[CAM_PHOTOS][CAM_PHOTO_W * CAM_PHOTO_H];
static uint8_t gamma_lut[1024];
static uint16_t preview_xmap[CAM_PREVIEW_W];

enum cam_cmd {
	CMD_START,
	CMD_STOP,
	CMD_FOCUS,
	CMD_SHOOT,
	CMD_SHOOT_FLASH,
};

K_MSGQ_DEFINE(cam_q, sizeof(uint8_t), 8, 1);

static struct k_spinlock lock;
static struct cam_status status = {.last_photo = -1};
static int latest = -1;
static int in_use = -1;
static uint32_t seq;

/* Thread state */
static bool powered;
static uint32_t exposure = 200U;
static uint32_t again = AGAIN_MIN;
static uint32_t wb_r = 256U, wb_b = 256U;
static uint32_t sharpness;

/* Autofocus: a coarse sweep, then a fine one around the best position */
#define AF_COARSE_STEP 85
#define AF_FINE_STEP   16
#define AF_FINE_SPAN   64
static struct {
	bool fine;
	int pos;
	int end;
	int step;
	int best_pos;
	uint32_t best;
	int settle;
} af;

/* Shot in progress: frames to wait with the flash on before capturing */
static int shot_frames = -1;
static bool shot_flash;
static uint32_t saved_exposure, saved_again;

static int sensor_write(uint16_t reg, const uint8_t *val, size_t len)
{
	uint8_t buf[4] = {reg >> 8, reg & 0xFF};

	memcpy(&buf[2], val, len);
	return i2c_write(i2c3, buf, 2 + len, SENSOR_ADDR);
}

static int sensor_write8(uint16_t reg, uint8_t val)
{
	return sensor_write(reg, &val, 1);
}

static int sensor_write_list(const struct cam_reg *regs, size_t n)
{
	for (size_t i = 0; i < n; i++) {
		int ret = sensor_write8(regs[i].addr, regs[i].val);

		if (ret != 0) {
			return ret;
		}
	}
	return 0;
}

static void sensor_set_exposure(void)
{
	uint8_t e[2] = {exposure & 0xFF, exposure >> 8};

	(void)sensor_write(REG_EXPOSURE, e, 2);
	(void)sensor_write8(REG_AGAIN_H, again >> 8);
	(void)sensor_write8(REG_AGAIN_L, again & 0xFF);
}

static void lens_set(uint16_t pos)
{
	uint16_t v = pos << LENS_SHIFT;
	uint8_t buf[2] = {v >> 8, v & 0xFF};

	(void)i2c_write(i2c3, buf, 2, LENS_ADDR);
	status.lens = pos;
}

static void hw_power_on(void)
{
	gpio_pin_configure(gpio4, 6, GPIO_OUTPUT_LOW);
	sys_write16(0x0004, PAD_CAM_D3);

	mfd_twl4030_reg_write(twl, TWL4030_ADDR_PM_MASTER, VAUX4_DEDICATED, 0x09);
	mfd_twl4030_reg_write(twl, TWL4030_ADDR_PM_MASTER, VAUX4_DEV_GRP, 0x20);

	sys_write32((sys_read32(PM_PWSTCTRL_CAM) & ~3U) | 3U, PM_PWSTCTRL_CAM);
	sys_write32(2U, CM_CLKSTCTRL_CAM);
	sys_write32(1U, CM_ICLKEN_CAM);
	sys_write32(3U, CM_FCLKEN_CAM);
	sys_write32(sys_read32(CM_CLKEN_PLL) & ~PWRDN_CAM, CM_CLKEN_PLL);
	/* cam_mclk = 864 MHz / 5 = 172.8 MHz; / 18 = 9.6 MHz on cam_xclka */
	sys_write32((sys_read32(CM_CLKSEL_CAM) & ~0x1FU) | 5U, CM_CLKSEL_CAM);
	k_msleep(1);
	sys_write32(1U << 12, ISP_SYSCONFIG);
	sys_write32((sys_read32(ISP_TCTRL) & ~0x1FU) | 18U, ISP_TCTRL);
	sys_write16(0x0000, PAD_CAM_XCLKA);
	k_msleep(1);
	gpio_pin_set(gpio4, 6, 1);
	k_msleep(5);

	/* CCP2 data/strobe lanes on cam_d6..d9, PHY powered in strobe mode */
	for (int i = 0; i < 4; i++) {
		sys_write16(0x0100, PAD_CAM_D6 + 2 * i);
	}
	sys_write32(BIT(13) | BIT(12) | BIT(10), CSIRXFE);

	sys_write32(BIT(1), CCP2_SYSCONFIG);
	while ((sys_read32(CCP2_SYSSTATUS) & BIT(0)) == 0U) {
	}
	sys_write32(1U << 12, CCP2_SYSCONFIG);
	/* CCP2 mode, data/strobe PHY, CCP2 output selected, memory port on */
	sys_write32(BIT(4) | BIT(2) | BIT(1), CCP2_CTRL);
	sys_write32(sys_read32(ISP_CTRL) | BIT(19), ISP_CTRL);
	sys_write32((LC0_FORMAT_RAW10 << 3) | BIT(2) | BIT(1), CCP2_LC0_CTRL);
	sys_write32((uint32_t)raw, CCP2_LC0_PING);
	sys_write32((uint32_t)raw, CCP2_LC0_PONG);
	sys_write32(RAW_STRIDE * 2, CCP2_LC0_OFST);
	sys_write32(0, CCP2_LC0_DAT_START);
	sys_write32(RAW_H << 16, CCP2_LC0_DAT_SIZE);
	sys_write32(sys_read32(CCP2_CTRL) | BIT(0), CCP2_CTRL);
}

static bool start(void)
{
	if (!powered) {
		hw_power_on();
		if ((sensor_write_list(poweron_regs, ARRAY_SIZE(poweron_regs)) != 0) ||
		    (sensor_write_list(vga_regs, ARRAY_SIZE(vga_regs)) != 0)) {
			return false;
		}
		powered = true;
		lens_set(LENS_MAX / 3);
	}
	sensor_set_exposure();
	sensor_write8(REG_STREAM, STREAM_ON);
	(void)led_set_brightness(flash, FLASH_LED_INDICATOR, 40);
	return true;
}

static void stop(void)
{
	if (powered) {
		sensor_write8(REG_STREAM, STREAM_OFF);
	}
	(void)led_set_brightness(flash, FLASH_LED_INDICATOR, 0);
}

static bool wait_status(uint32_t bit, int64_t timeout_ms)
{
	int64_t end = k_uptime_get() + timeout_ms;

	while ((sys_read32(CCP2_LC01_IRQSTAT) & bit) == 0U) {
		if (k_uptime_get() > end) {
			return false;
		}
		k_msleep(1);
	}
	return true;
}

/* One whole frame: enable the channel, wait for a start, then the end */
static int capture(void)
{
	uint32_t st;

	sys_write32(0xFFFFFFFFU, CCP2_LC01_IRQSTAT);
	sys_write32(sys_read32(CCP2_LC0_CTRL) | BIT(0), CCP2_LC0_CTRL);
	if (!wait_status(LC0_FS, 200)) {
		sys_write32(sys_read32(CCP2_LC0_CTRL) & ~BIT(0), CCP2_LC0_CTRL);
		return -ETIMEDOUT;
	}
	sys_write32(0xFFFFFFFFU, CCP2_LC01_IRQSTAT);
	if (!wait_status(LC0_FE, 200)) {
		sys_write32(sys_read32(CCP2_LC0_CTRL) & ~BIT(0), CCP2_LC0_CTRL);
		return -ETIMEDOUT;
	}
	st = sys_read32(CCP2_LC01_IRQSTAT);
	sys_write32(sys_read32(CCP2_LC0_CTRL) & ~BIT(0), CCP2_LC0_CTRL);
	sys_cache_data_invd_range(raw, sizeof(raw));

	return ((st & LC0_ERRORS) != 0U) ? -EIO : 0;
}

/* Channel gains, scaled so the smallest is 1 and 959 above black maps to 1023 */
static void channel_gains(uint32_t *gr, uint32_t *gg, uint32_t *gb)
{
	const uint32_t norm = 273U;
	uint32_t wb_min = MIN(MIN(wb_r, wb_b), 256U);

	*gr = wb_r * norm / wb_min;
	*gg = 256U * norm / wb_min;
	*gb = wb_b * norm / wb_min;
}

static inline uint8_t tone(int32_t v, uint32_t gain)
{
	v -= BLACK_LEVEL;
	if (v < 0) {
		v = 0;
	}
	v = (v * (int32_t)gain) >> 8;
	return gamma_lut[MIN(v, 1023)];
}

static inline uint32_t rgb(uint8_t r, uint8_t g, uint8_t b)
{
	return ((uint32_t)r << 16) | ((uint32_t)g << 8) | b;
}

/*
 * One colour per GRBG 2x2 cell, turned 180 degrees since the sensor is
 * mounted upside down, scaled up into a preview buffer. Also measures the
 * mean green level, the channel averages for white balance and the
 * contrast in the middle of the frame for autofocus. Returns the mean green.
 */
static uint32_t develop_preview(uint32_t *out)
{
	uint64_t sum_r = 0, sum_g = 0, sum_b = 0, sharp = 0;
	uint32_t gr, gg, gb;

	channel_gains(&gr, &gg, &gb);
	for (int cy = 0; cy < CELLS_H; cy++) {
		const uint16_t *r0 = raw[2 * cy];
		const uint16_t *r1 = raw[2 * cy + 1];
		uint32_t *dst = cells[CELLS_H - 1 - cy];
		bool mid_y = (cy > CELLS_H / 3) && (cy < 2 * CELLS_H / 3);

		for (int cx = 0; cx < CELLS_W; cx++) {
			int32_t g = (r0[2 * cx] + r1[2 * cx + 1]) / 2;
			int32_t r = r0[2 * cx + 1];
			int32_t b = r1[2 * cx];

			sum_r += r;
			sum_g += g;
			sum_b += b;
			if (mid_y && (cx > CELLS_W / 3) && (cx < 2 * CELLS_W / 3)) {
				int32_t gx = r0[2 * cx + 2] - r0[2 * cx];
				int32_t gy = raw[2 * cy + 2][2 * cx] - r0[2 * cx];

				sharp += (uint32_t)(gx * gx + gy * gy);
			}
			dst[CELLS_W - 1 - cx] = rgb(tone(r, gr), tone(g, gg), tone(b, gb));
		}
	}

	for (int oy = 0; oy < CAM_PREVIEW_H; oy++) {
		const uint32_t *src = cells[oy * CELLS_H / CAM_PREVIEW_H];
		uint32_t *dst = &out[oy * CAM_PREVIEW_W];

		for (int ox = 0; ox < CAM_PREVIEW_W; ox++) {
			dst[ox] = src[preview_xmap[ox]];
		}
	}

	uint32_t n = CELLS_W * CELLS_H;
	int32_t mr = (int32_t)(sum_r / n) - BLACK_LEVEL;
	int32_t mg = (int32_t)(sum_g / n) - BLACK_LEVEL;
	int32_t mb = (int32_t)(sum_b / n) - BLACK_LEVEL;

	/* Gray world, smoothed */
	if ((mr > 4) && (mb > 4) && (mg > 4)) {
		wb_r = (3 * wb_r + CLAMP((uint32_t)(256 * mg / mr), 128U, 1024U)) / 4;
		wb_b = (3 * wb_b + CLAMP((uint32_t)(256 * mg / mb), 128U, 1024U)) / 4;
	}
	/* Contrast relative to brightness, so exposure changes matter less */
	sharpness = (uint32_t)(sharp / (uint64_t)MAX(mg, 8));
	return MAX(mg, 0);
}

static inline int32_t px(int x, int y)
{
	return raw[y][x];
}

/* Full-resolution bilinear demosaic of the middle 640x480, turned 180 degrees */
static void develop_photo(uint32_t *out)
{
	const int x0 = (RAW_W - CAM_PHOTO_W) / 2, y0 = (RAW_H - CAM_PHOTO_H) / 2;
	uint32_t gr, gg, gb;

	channel_gains(&gr, &gg, &gb);
	for (int y = 0; y < CAM_PHOTO_H; y++) {
		int Y = y0 + y;
		uint32_t *dst = &out[(CAM_PHOTO_H - 1 - y) * CAM_PHOTO_W + CAM_PHOTO_W - 1];

		for (int x = 0; x < CAM_PHOTO_W; x++, dst--) {
			int X = x0 + x;
			int32_t r, g, b;
			int32_t cross = (px(X - 1, Y) + px(X + 1, Y) + px(X, Y - 1) + px(X, Y + 1)) / 4;
			int32_t diag = (px(X - 1, Y - 1) + px(X + 1, Y - 1) + px(X - 1, Y + 1) +
					px(X + 1, Y + 1)) / 4;
			int32_t horiz = (px(X - 1, Y) + px(X + 1, Y)) / 2;
			int32_t vert = (px(X, Y - 1) + px(X, Y + 1)) / 2;

			if ((Y & 1) == 0) {
				if ((X & 1) == 0) { /* G on a red row */
					g = px(X, Y);
					r = horiz;
					b = vert;
				} else { /* R */
					r = px(X, Y);
					g = cross;
					b = diag;
				}
			} else {
				if ((X & 1) == 0) { /* B */
					b = px(X, Y);
					g = cross;
					r = diag;
				} else { /* G on a blue row */
					g = px(X, Y);
					b = horiz;
					r = vert;
				}
			}
			*dst = rgb(tone(r, gr), tone(g, gg), tone(b, gb));
		}
	}
}

/* Exposure first, then analog gain, towards a mid-grey green level */
static void auto_exposure(uint32_t mean, bool fast)
{
	const uint32_t target = 110U;
	uint32_t old_e = exposure, old_g = again;
	uint32_t want;

	mean = MAX(mean, 1U);
	if ((mean * 10U >= target * 9U) && (mean * 10U <= target * 11U)) {
		return;
	}
	want = exposure * again * target / mean;
	if (want <= EXPOSURE_MAX * AGAIN_MIN) {
		again = AGAIN_MIN;
		exposure = CLAMP(want / AGAIN_MIN, 2U, EXPOSURE_MAX);
	} else {
		exposure = EXPOSURE_MAX;
		again = CLAMP(want / EXPOSURE_MAX, AGAIN_MIN, AGAIN_MAX);
	}
	if (!fast) {
		/* Move half way to damp oscillation */
		exposure = (exposure + old_e) / 2U;
		again = (again + old_g) / 2U;
	}
	if ((exposure != old_e) || (again != old_g)) {
		sensor_set_exposure();
	}
}

static void af_begin(void)
{
	af.fine = false;
	af.pos = 0;
	af.end = LENS_MAX;
	af.step = AF_COARSE_STEP;
	af.best = 0;
	af.best_pos = 0;
	af.settle = 2;
	lens_set(0);
	status.focus = CAM_FOCUS_SCANNING;
}

/* One frame of the sweep: the lens moved two frames ago, so this one is sharp */
static void af_frame(void)
{
	if (af.settle > 0) {
		af.settle--;
		return;
	}
	if (sharpness > af.best) {
		af.best = sharpness;
		af.best_pos = af.pos;
	}
	af.pos += af.step;
	if (af.pos > af.end) {
		if (!af.fine) {
			af.fine = true;
			af.step = AF_FINE_STEP;
			af.pos = MAX(af.best_pos - AF_FINE_SPAN, 0);
			af.end = MIN(af.best_pos + AF_FINE_SPAN, (int)LENS_MAX);
		} else {
			lens_set(af.best_pos);
			status.focus = CAM_FOCUS_LOCKED;
			return;
		}
	}
	lens_set(af.pos);
	af.settle = 1;
}

static void shot_begin(bool use_flash)
{
	shot_flash = use_flash;
	status.shooting = true;
	if (use_flash) {
		saved_exposure = exposure;
		saved_again = again;
		(void)led_set_brightness(flash, FLASH_LED_FLASH, 100);
		/* Let exposure settle on the flash-lit scene, within its 500 ms */
		shot_frames = 4;
	} else {
		shot_frames = 0;
	}
}

static void shot_frame(void)
{
	int slot;

	if (shot_frames > 0) {
		shot_frames--;
		return;
	}
	slot = (status.last_photo + 1) % CAM_PHOTOS;
	develop_photo(photos[slot]);
	shot_frames = -1;
	if (shot_flash) {
		exposure = saved_exposure;
		again = saved_again;
		sensor_set_exposure();
	}

	k_spinlock_key_t key = k_spin_lock(&lock);

	status.last_photo = slot;
	status.photos++;
	status.shooting = false;
	k_spin_unlock(&lock, key);
}

static void handle(uint8_t cmd)
{
	switch (cmd) {
	case CMD_START:
		if (!status.running) {
			status.sensor_ok = start();
			status.running = status.sensor_ok;
		}
		break;
	case CMD_STOP:
		if (status.running) {
			stop();
			status.running = false;
			status.focus = CAM_FOCUS_IDLE;
			shot_frames = -1;
			status.shooting = false;
		}
		break;
	case CMD_FOCUS:
		if (status.running) {
			af_begin();
		}
		break;
	case CMD_SHOOT:
	case CMD_SHOOT_FLASH:
		if (status.running && (shot_frames < 0)) {
			shot_begin(cmd == CMD_SHOOT_FLASH);
		}
		break;
	}
}

static int next_buffer(void)
{
	for (int i = 0; i < 3; i++) {
		if ((i != latest) && (i != in_use)) {
			return i;
		}
	}
	return 0;
}

static void cam_thread(void *a, void *b, void *c)
{
	uint32_t frames = 0;
	int64_t t_fps = k_uptime_get();

	for (;;) {
		k_timeout_t wait = status.running ? K_NO_WAIT : K_FOREVER;
		uint8_t cmd;
		uint32_t mean;
		int buf;

		while (k_msgq_get(&cam_q, &cmd, wait) == 0) {
			handle(cmd);
			wait = K_NO_WAIT;
		}
		if (!status.running) {
			continue;
		}

		if (capture() == -ETIMEDOUT) {
			k_msleep(100);
			continue;
		}

		buf = next_buffer();
		mean = develop_preview(previews[buf]);

		if (shot_frames >= 0) {
			shot_frame();
		}
		if (status.focus == CAM_FOCUS_SCANNING) {
			af_frame();
		} else {
			auto_exposure(mean, shot_frames >= 0);
		}

		k_spinlock_key_t key = k_spin_lock(&lock);

		latest = buf;
		seq++;
		status.exposure = exposure;
		status.gain_x10 = again * 10U / AGAIN_MIN;
		k_spin_unlock(&lock, key);

		frames++;
		if (k_uptime_get() - t_fps >= 1000) {
			status.fps = frames;
			frames = 0;
			t_fps = k_uptime_get();
		}
	}
}

K_THREAD_STACK_DEFINE(cam_stack, 4096);
static struct k_thread cam_tid;

void cam_init(void)
{
	for (int i = 0; i < 1024; i++) {
		gamma_lut[i] = (uint8_t)(powf(i / 1023.0f, 1.0f / 2.2f) * 255.0f + 0.5f);
	}
	for (int ox = 0; ox < CAM_PREVIEW_W; ox++) {
		preview_xmap[ox] = (uint16_t)(ox * CELLS_W / CAM_PREVIEW_W);
	}
	/* Below the UI thread, so the preview never starves the interface */
	k_thread_create(&cam_tid, cam_stack, K_THREAD_STACK_SIZEOF(cam_stack), cam_thread, NULL,
			NULL, NULL, 12, 0, K_NO_WAIT);
}

static void post(uint8_t cmd)
{
	(void)k_msgq_put(&cam_q, &cmd, K_NO_WAIT);
}

void cam_start(void)
{
	post(CMD_START);
}

void cam_stop(void)
{
	post(CMD_STOP);
}

void cam_focus(void)
{
	post(CMD_FOCUS);
}

void cam_shoot(bool use_flash)
{
	post(use_flash ? CMD_SHOOT_FLASH : CMD_SHOOT);
}

const uint32_t *cam_preview(uint32_t *seq_out)
{
	k_spinlock_key_t key = k_spin_lock(&lock);
	const uint32_t *p = (latest >= 0) ? previews[latest] : NULL;

	*seq_out = seq;
	k_spin_unlock(&lock, key);
	return p;
}

void cam_preview_in_use(const uint32_t *buf)
{
	k_spinlock_key_t key = k_spin_lock(&lock);

	in_use = -1;
	for (int i = 0; i < 3; i++) {
		if (buf == previews[i]) {
			in_use = i;
		}
	}
	k_spin_unlock(&lock, key);
}

const uint32_t *cam_photo(int slot)
{
	return ((slot >= 0) && (slot < CAM_PHOTOS)) ? photos[slot] : NULL;
}

void cam_status_get(struct cam_status *out)
{
	k_spinlock_key_t key = k_spin_lock(&lock);

	*out = status;
	k_spin_unlock(&lock, key);
}
```

## src/camera.h
```c
/* N900 phone demo: main camera */
#ifndef CAMERA_H_
#define CAMERA_H_

#include <stdbool.h>
#include <stdint.h>

#define CAM_PREVIEW_W 480
#define CAM_PREVIEW_H 360
#define CAM_PHOTO_W   640
#define CAM_PHOTO_H   480
#define CAM_PHOTOS    6

enum cam_focus_state {
	CAM_FOCUS_IDLE,
	CAM_FOCUS_SCANNING,
	CAM_FOCUS_LOCKED,
};

struct cam_status {
	bool running;
	bool sensor_ok;
	uint32_t fps;
	uint32_t exposure;
	uint32_t gain_x10;
	enum cam_focus_state focus;
	uint16_t lens;
	bool shooting;
	int photos;      /* photos taken so far */
	int last_photo;  /* slot of the newest photo, -1 if none */
};

/* Requests, handled by the camera thread */
void cam_init(void);
void cam_start(void);
void cam_stop(void);
void cam_focus(void);
void cam_shoot(bool flash);

/* The newest preview frame (XRGB8888), and its sequence number */
const uint32_t *cam_preview(uint32_t *seq);
/* Tells the camera thread which preview buffer the UI is showing */
void cam_preview_in_use(const uint32_t *buf);
const uint32_t *cam_photo(int slot);
void cam_status_get(struct cam_status *out);

#endif
```

## src/hw.c
```c
/* N900 phone demo: hardware side */
#include <zephyr/kernel.h>
#include <zephyr/drivers/charger.h>
#include <zephyr/drivers/display.h>
#include <zephyr/drivers/fuel_gauge.h>
#include <zephyr/drivers/haptics.h>
#include <zephyr/drivers/led.h>
#include <zephyr/drivers/mfd/twl4030.h>
#include <zephyr/drivers/sensor.h>
#include <zephyr/input/input.h>
#include <lvgl.h>

#include "phone.h"

static const struct device *const display = DEVICE_DT_GET(DT_CHOSEN(zephyr_display));
static const struct device *const touch = DEVICE_DT_GET(DT_NODELABEL(touchscreen));
static const struct device *const leds = DEVICE_DT_GET(DT_NODELABEL(leds));
static const struct device *const accel = DEVICE_DT_GET(DT_NODELABEL(accelerometer));
static const struct device *const light = DEVICE_DT_GET(DT_NODELABEL(light_sensor));
static const struct device *const gauge = DEVICE_DT_GET(DT_NODELABEL(fuel_gauge));
static const struct device *const charger = DEVICE_DT_GET(DT_NODELABEL(charger));
static const struct device *const twl = DEVICE_DT_GET(DT_NODELABEL(twl));
static const struct device *const flash = DEVICE_DT_GET(DT_NODELABEL(flash));
static const struct device *const vibrator = DEVICE_DT_GET(DT_NODELABEL(vibrator));

/* LP5523 channels */
#define LED_BLUE  4U
#define LED_GREEN 5U
#define LED_RED   6U
static const uint8_t kbd_leds[] = {0, 1, 2, 3, 7, 8};

K_MSGQ_DEFINE(phone_q, sizeof(struct phone_event), 64, 4);

static struct phone_sensors sensors;
static struct k_spinlock sensors_lock;

void phone_post(uint8_t type, uint16_t code, int32_t value)
{
	struct phone_event e = {.type = type, .code = code, .value = value};

	(void)k_msgq_put(&phone_q, &e, K_NO_WAIT);
}

void phone_sensors_get(struct phone_sensors *out)
{
	k_spinlock_key_t key = k_spin_lock(&sensors_lock);

	*out = sensors;
	k_spin_unlock(&sensors_lock, key);
}

/* Keys and switches, everything but the touchscreen, which LVGL reads */
static void input_cb(struct input_event *evt, void *user_data)
{
	ARG_UNUSED(user_data);

	if (evt->dev == touch) {
		return;
	}

	if (evt->type == INPUT_EV_KEY) {
		phone_post(PEV_KEY, evt->code, evt->value);
	} else if (evt->type == INPUT_EV_SW) {
		phone_post(PEV_SWITCH, evt->code, evt->value);
	}
}
INPUT_CALLBACK_DEFINE(NULL, input_cb, NULL);

static void tap_cb(const struct device *dev, const struct sensor_trigger *trig)
{
	phone_post(PEV_TAP, 0, 0);
}

static bool vbus_present(void)
{
	uint8_t sts = 0U;

	(void)mfd_twl4030_reg_read(twl, TWL4030_ADDR_PM_MASTER, TWL4030_STS_HW_CONDITIONS, &sts);
	return (sts & TWL4030_STS_VBUS) != 0U;
}

static void usb_cb(const struct device *dev, struct twl4030_irq_callback *cb, uint8_t status)
{
	phone_post(PEV_USB, 0, vbus_present());
}

static struct twl4030_irq_callback usb_irq = {
	.handler = usb_cb,
	.module = TWL4030_IRQ_POWER,
	.mask = TWL4030_POWER_IRQ_USB_PRES,
};

/* Accelerometer at 20 Hz */
static void accel_thread(void *a, void *b, void *c)
{
	struct sensor_value v[3];

	while (true) {
		if (device_is_ready(accel) && (sensor_sample_fetch(accel) == 0) &&
		    (sensor_channel_get(accel, SENSOR_CHAN_ACCEL_XYZ, v) == 0)) {
			k_spinlock_key_t key = k_spin_lock(&sensors_lock);

			sensors.accel_ok = true;
			sensors.ax = v[0].val1 * 100 + v[0].val2 / 10000;
			sensors.ay = v[1].val1 * 100 + v[1].val2 / 10000;
			sensors.az = v[2].val1 * 100 + v[2].val2 / 10000;
			k_spin_unlock(&sensors_lock, key);
		}
		k_msleep(50);
	}
}

/* Light every second (the sensor integrates for 402 ms), battery every 5 s */
static void slow_thread(void *a, void *b, void *c)
{
	for (uint32_t n = 0U;; n++) {
		struct sensor_value lux;
		bool light_ok = device_is_ready(light) && (sensor_sample_fetch(light) == 0) &&
				(sensor_channel_get(light, SENSOR_CHAN_LIGHT, &lux) == 0);
		k_spinlock_key_t key = k_spin_lock(&sensors_lock);

		sensors.light_ok = light_ok;
		if (light_ok) {
			sensors.lux = lux.val1;
		}
		k_spin_unlock(&sensors_lock, key);

		if ((n % 5U) == 0U) {
			union fuel_gauge_prop_val v;
			union charger_propval cv;
			struct phone_sensors s = {0};

			s.gauge_ok = device_is_ready(gauge) &&
				     (fuel_gauge_get_prop(gauge,
							  FUEL_GAUGE_RELATIVE_STATE_OF_CHARGE_PCT,
							  &v) == 0);
			if (s.gauge_ok) {
				s.soc = v.relative_state_of_charge_pct;
				fuel_gauge_get_prop(gauge, FUEL_GAUGE_VOLTAGE_UV, &v);
				s.mv = v.voltage_uv / 1000;
				fuel_gauge_get_prop(gauge, FUEL_GAUGE_CURRENT_UA, &v);
				s.ma = v.current_ua / 1000;
				fuel_gauge_get_prop(gauge, FUEL_GAUGE_TEMPERATURE_DK, &v);
				s.temp_dc = (int)v.temperature_dk - 2731;
			}
			s.charger = CHARGER_STATUS_UNKNOWN;
			if (device_is_ready(charger) &&
			    (charger_get_prop(charger, CHARGER_PROP_STATUS, &cv) == 0)) {
				s.charger = cv.status;
			}
			s.vbus = vbus_present();

			key = k_spin_lock(&sensors_lock);
			sensors.gauge_ok = s.gauge_ok;
			sensors.soc = s.soc;
			sensors.mv = s.mv;
			sensors.ma = s.ma;
			sensors.temp_dc = s.temp_dc;
			sensors.charger = s.charger;
			sensors.vbus = s.vbus;
			k_spin_unlock(&sensors_lock, key);
		}
		k_msleep(600);
	}
}

K_THREAD_STACK_DEFINE(accel_stack, 2048);
K_THREAD_STACK_DEFINE(slow_stack, 2048);
static struct k_thread accel_tid;
static struct k_thread slow_tid;

void hw_init(void)
{
	static const struct sensor_trigger tap = {SENSOR_TRIG_TAP, SENSOR_CHAN_ALL};

	if (device_is_ready(accel)) {
		(void)sensor_trigger_set(accel, &tap, tap_cb);
	}
	(void)mfd_twl4030_add_irq_callback(twl, &usb_irq);

	k_thread_create(&accel_tid, accel_stack, K_THREAD_STACK_SIZEOF(accel_stack),
			accel_thread, NULL, NULL, NULL, 10, 0, K_NO_WAIT);
	k_thread_create(&slow_tid, slow_stack, K_THREAD_STACK_SIZEOF(slow_stack), slow_thread,
			NULL, NULL, NULL, 11, 0, K_NO_WAIT);
}

void hw_screen(bool on, uint8_t brightness)
{
	if (on) {
		(void)display_blanking_off(display);
		(void)display_set_brightness(display, brightness);
	} else {
		(void)display_set_brightness(display, 0);
		(void)display_blanking_on(display);
	}
}

void hw_kbd_backlight(uint8_t pct)
{
	static int last = -1;

	if (pct == last) {
		return;
	}
	last = pct;

	for (size_t i = 0; i < ARRAY_SIZE(kbd_leds); i++) {
		led_set_brightness(leds, kbd_leds[i], pct);
	}
}

void hw_status_led(uint8_t r, uint8_t g, uint8_t b)
{
	static uint32_t last = UINT32_MAX;
	uint32_t rgb = ((uint32_t)r << 16) | ((uint32_t)g << 8) | b;
	uint8_t ch[3] = {b, g, r};

	if (rgb == last) {
		return;
	}
	last = rgb;

	/* Blue, green and red are consecutive channels */
	for (int i = 0; i < 3; i++) {
		ch[i] = (uint8_t)((ch[i] * 255U) / 100U);
	}
	(void)led_write_channels(leds, LED_BLUE, 3, ch);
}

/* The camera flash LED in its continuous torch mode */
void hw_torch(bool on)
{
	(void)led_set_brightness(flash, 0, on ? 100 : 0);
}

static void vibra_off(struct k_work *work)
{
	(void)haptics_stop_output(vibrator);
}

static K_WORK_DELAYABLE_DEFINE(vibra_work, vibra_off);

/* Runs the motor for a while; a new call restarts the time */
void hw_vibrate(uint32_t ms)
{
	if (!device_is_ready(vibrator)) {
		return;
	}
	(void)haptics_start_output(vibrator);
	k_work_reschedule(&vibra_work, K_MSEC(ms));
}

/* Main loop: drain the event queue and run LVGL */
int main(void)
{
	struct phone_event e;

	ui_init();
	hw_init();

	while (true) {
		while (k_msgq_get(&phone_q, &e, K_NO_WAIT) == 0) {
			ui_event(&e);
		}
		uint32_t sleep = lv_timer_handler();

		k_msleep(CLAMP(sleep, 5U, 30U));
	}
	return 0;
}
```

## src/phone.h
```c
/* N900 phone demo: shared definitions */
#ifndef PHONE_H_
#define PHONE_H_

#include <stdbool.h>
#include <stdint.h>

enum phone_event_type {
	PEV_KEY,    /* code, value: key press/release */
	PEV_SWITCH, /* code, value: INPUT_SW_* */
	PEV_TAP,    /* accelerometer tap */
	PEV_USB,    /* value: VBUS present */
};

struct phone_event {
	uint8_t type;
	uint16_t code;
	int32_t value;
};

/* Latest sensor readings, refreshed by the sensor threads */
struct phone_sensors {
	bool gauge_ok;
	int soc;           /* % */
	int mv;            /* battery voltage */
	int ma;            /* battery current, positive while charging */
	int temp_dc;       /* deci-degrees Celsius */
	int charger;       /* enum charger_status */
	bool vbus;
	bool light_ok;
	int lux;
	bool accel_ok;
	int ax, ay, az;    /* centi m/s^2 */
};

void phone_post(uint8_t type, uint16_t code, int32_t value);
void phone_sensors_get(struct phone_sensors *out);

/* Hardware control, LVGL thread only */
void hw_init(void);
void hw_screen(bool on, uint8_t brightness);
void hw_kbd_backlight(uint8_t pct);
void hw_status_led(uint8_t r, uint8_t g, uint8_t b);
void hw_torch(bool on);
void hw_vibrate(uint32_t ms);

/* UI, LVGL thread only */
void ui_init(void);
void ui_event(const struct phone_event *e);

#endif
```

## src/sound.c
```c
/*
 * N900 phone demo: sounds on the loudspeakers. A thread synthesizes tone
 * sequences into I2S blocks for McBSP2; the TLV320AIC34 plays them and the
 * speaker amplifier is on only while the stream runs.
 */
#include <math.h>
#include <string.h>
#include <zephyr/audio/codec.h>
#include <zephyr/drivers/gpio.h>
#include <zephyr/drivers/i2s.h>
#include <zephyr/kernel.h>

#include "sound.h"

#define RATE     48000
#define FRAMES   480 /* 10 ms */
#define BLOCK    (FRAMES * 2 * sizeof(int16_t))
#define BLOCKS   8
#define PRIME    3
/* Fade in and out over 3 ms to avoid clicks */
#define FADE     144
#define IDLE_MS  2000
#define TWO_PI   6.2831853f

static const struct device *const i2s = DEVICE_DT_GET(DT_NODELABEL(mcbsp2));
static const struct device *const codec = DEVICE_DT_GET(DT_NODELABEL(codec));
static const struct gpio_dt_spec amp = GPIO_DT_SPEC_GET(DT_PATH(zephyr_user), speaker_amp_gpios);

K_MEM_SLAB_DEFINE_STATIC(slab, BLOCK, BLOCKS, 32);

struct note {
	uint16_t f1;
	uint16_t f2;   /* second tone, 0 for none */
	uint16_t ms;
	uint8_t level; /* percent, 0 is a rest */
	bool noise;
};

struct sequence {
	const struct note *notes;
	uint8_t count;
	bool loop;
};

#define N(f, ms)         {(f), 0, (ms), 60, false}
#define REST(ms)         {0, 0, (ms), 0, false}
#define DUAL(a, b, ms)   {(a), (b), (ms), 50, false}

static const struct note click[] = {{1800, 0, 6, 25, false}};
/* An original ringing phrase, then a pause */
static const struct note ringtone[] = {
	N(659, 110), REST(20), N(784, 110), REST(20), N(1047, 110), REST(20), N(784, 110),
	REST(20), N(880, 110), REST(20), N(1175, 220), REST(900),
};
/* European ringback: 425 Hz, one second on, four off */
static const struct note ringback[] = {{425, 0, 1000, 35, false}, REST(4000)};
static const struct note call_end[] = {N(587, 120), REST(40), N(440, 200)};
static const struct note message[] = {N(1047, 90), REST(30), N(1319, 160)};
static const struct note shutter[] = {
	{0, 0, 25, 60, true}, REST(45), {0, 0, 35, 45, true},
};
static const struct note charger[] = {N(784, 80), REST(20), N(1047, 120)};
static const struct note startup[] = {
	N(523, 120), N(659, 120), N(784, 120), N(1047, 360),
};

static const struct sequence sequences[SOUND_COUNT] = {
	[SOUND_CLICK] = {click, ARRAY_SIZE(click), false},
	[SOUND_RINGTONE] = {ringtone, ARRAY_SIZE(ringtone), true},
	[SOUND_RINGBACK] = {ringback, ARRAY_SIZE(ringback), true},
	[SOUND_CALL_END] = {call_end, ARRAY_SIZE(call_end), false},
	[SOUND_MESSAGE] = {message, ARRAY_SIZE(message), false},
	[SOUND_SHUTTER] = {shutter, ARRAY_SIZE(shutter), false},
	[SOUND_CHARGER] = {charger, ARRAY_SIZE(charger), false},
	[SOUND_STARTUP] = {startup, ARRAY_SIZE(startup), false},
};

/* A DTMF key is a sequence of one note */
static struct note dtmf_note;
static struct sequence dtmf_seq = {&dtmf_note, 1, false};

struct request {
	const struct sequence *seq; /* NULL stops */
};

K_MSGQ_DEFINE(sound_q, sizeof(struct request), 8, 4);

/* Player state, sound thread only */
static const struct sequence *cur;
static int note_idx;
static uint32_t note_pos;
static uint32_t note_len;
static float ph1, ph2;
static bool streaming;
static int64_t idle_since;

/* Noise for the shutter; quality does not matter */
static uint32_t lcg = 12345U;

static float noise(void)
{
	lcg = lcg * 1664525U + 1013904223U;
	return ((float)(lcg >> 16) / 32768.0f) - 1.0f;
}

static void note_start(void)
{
	note_pos = 0U;
	note_len = (uint32_t)cur->notes[note_idx].ms * RATE / 1000U;
}

static int16_t sample(const struct note *n)
{
	float env = 1.0f;
	float v;

	if (n->level == 0U) {
		return 0;
	}
	if (note_pos < FADE) {
		env = (float)note_pos / FADE;
	} else if (note_len - note_pos < FADE) {
		env = (float)(note_len - note_pos) / FADE;
	}
	if (n->noise) {
		v = noise();
	} else {
		v = sinf(ph1);
		ph1 += TWO_PI * n->f1 / RATE;
		if (ph1 > TWO_PI) {
			ph1 -= TWO_PI;
		}
		if (n->f2 != 0U) {
			v = 0.5f * (v + sinf(ph2));
			ph2 += TWO_PI * n->f2 / RATE;
			if (ph2 > TWO_PI) {
				ph2 -= TWO_PI;
			}
		}
	}
	return (int16_t)(v * env * n->level * 300.0f);
}

/* Fills a block from the current sequence, silence once it has ended */
static void fill(int16_t *buf)
{
	for (int i = 0; i < FRAMES; i++) {
		int16_t s = 0;

		if (cur != NULL) {
			s = sample(&cur->notes[note_idx]);
			if (++note_pos >= note_len) {
				if (++note_idx >= cur->count) {
					note_idx = 0;
					if (!cur->loop) {
						cur = NULL;
					}
				}
				if (cur != NULL) {
					note_start();
				}
			}
		}
		buf[2 * i] = s;
		buf[2 * i + 1] = s;
	}
}

static int write_block(void)
{
	void *blk;
	int ret;

	ret = k_mem_slab_alloc(&slab, &blk, K_MSEC(200));
	if (ret != 0) {
		return ret;
	}
	fill(blk);
	ret = i2s_write(i2s, blk, BLOCK);
	if (ret != 0) {
		k_mem_slab_free(&slab, blk);
	}
	return ret;
}

static void stream_start(void)
{
	int ret;

	/* The previous stream may still be draining */
	for (int i = 0; i < 20; i++) {
		ret = i2s_trigger(i2s, I2S_DIR_TX, I2S_TRIGGER_DROP);
		if (ret == 0) {
			break;
		}
		k_msleep(5);
	}
	gpio_pin_set_dt(&amp, 1);
	for (int i = 0; i < PRIME; i++) {
		(void)write_block();
	}
	if (i2s_trigger(i2s, I2S_DIR_TX, I2S_TRIGGER_START) == 0) {
		streaming = true;
	}
}

static void stream_stop(void)
{
	(void)i2s_trigger(i2s, I2S_DIR_TX, I2S_TRIGGER_DRAIN);
	streaming = false;
	/* Let the last blocks play out before the amplifier goes off */
	k_msleep(BLOCKS * 10 + 30);
	gpio_pin_set_dt(&amp, 0);
}

static void sound_thread(void *a, void *b, void *c)
{
	struct audio_codec_cfg ccfg = {
		.mclk_freq = 19200000,
		.dai_type = AUDIO_DAI_TYPE_PCMA,
		.dai_route = AUDIO_ROUTE_PLAYBACK,
		.dai_cfg.i2s = {
			.word_size = 16,
			.channels = 2,
			.frame_clk_freq = RATE,
			.options = I2S_OPT_BIT_CLK_CONTROLLER | I2S_OPT_FRAME_CLK_CONTROLLER,
		},
	};
	struct i2s_config icfg = {
		.word_size = 16,
		.channels = 2,
		.format = I2S_FMT_DATA_FORMAT_PCM_SHORT,
		.options = I2S_OPT_BIT_CLK_TARGET | I2S_OPT_FRAME_CLK_TARGET,
		.frame_clk_freq = RATE,
		.mem_slab = &slab,
		.block_size = BLOCK,
		.timeout = 200,
	};

	if (!device_is_ready(i2s) || !device_is_ready(codec) || !gpio_is_ready_dt(&amp) ||
	    (audio_codec_configure(codec, &ccfg) != 0) ||
	    (i2s_configure(i2s, I2S_DIR_TX, &icfg) != 0)) {
		printk("sound: not available\n");
		return;
	}
	gpio_pin_configure_dt(&amp, GPIO_OUTPUT_INACTIVE);
	audio_codec_start_output(codec);

	for (;;) {
		struct request req;
		k_timeout_t wait = streaming ? K_NO_WAIT : K_FOREVER;

		while (k_msgq_get(&sound_q, &req, wait) == 0) {
			wait = K_NO_WAIT;
			cur = req.seq;
			note_idx = 0;
			ph1 = 0.0f;
			ph2 = 0.0f;
			if (cur != NULL) {
				note_start();
				idle_since = 0;
				if (!streaming) {
					stream_start();
				}
			}
		}
		if (!streaming) {
			continue;
		}

		if (write_block() == -EIO) {
			/* Underrun: start over */
			(void)i2s_trigger(i2s, I2S_DIR_TX, I2S_TRIGGER_PREPARE);
			streaming = false;
			gpio_pin_set_dt(&amp, 0);
			continue;
		}

		if (cur == NULL) {
			if (idle_since == 0) {
				idle_since = k_uptime_get();
			} else if (k_uptime_get() - idle_since > IDLE_MS) {
				stream_stop();
			}
		}
	}
}

K_THREAD_STACK_DEFINE(sound_stack, 2048);
static struct k_thread sound_tid;

void sound_init(void)
{
	k_thread_create(&sound_tid, sound_stack, K_THREAD_STACK_SIZEOF(sound_stack), sound_thread,
			NULL, NULL, NULL, 5, 0, K_NO_WAIT);
}

static void post(const struct sequence *seq)
{
	struct request req = {.seq = seq};

	(void)k_msgq_put(&sound_q, &req, K_NO_WAIT);
}

void sound_play(enum sound_id id)
{
	if (id < SOUND_COUNT) {
		post(&sequences[id]);
	}
}

void sound_dtmf(char key)
{
	static const uint16_t rows[] = {697, 770, 852, 941};
	static const uint16_t cols[] = {1209, 1336, 1477};
	static const char keys[] = "123456789*0#";
	const char *p = strchr(keys, key);
	int i;

	if ((p == NULL) || (key == '\0')) {
		return;
	}
	i = p - keys;
	/* The sound thread reads the note once the request arrives */
	dtmf_note = (struct note)DUAL(rows[i / 3], cols[i % 3], 140);
	post(&dtmf_seq);
}

void sound_stop(void)
{
	post(NULL);
}

void sound_set_volume(int pct)
{
	audio_property_value_t v;

	pct = CLAMP(pct, 0, 100);
	v.mute = (pct == 0);
	audio_codec_set_property(codec, AUDIO_PROPERTY_OUTPUT_MUTE, AUDIO_CHANNEL_ALL, v);
	/* 0.5 dB steps: 100 % is 0 dB, 1 % is -40 dB */
	v.vol = -((100 - pct) * 80 / 100);
	audio_codec_set_property(codec, AUDIO_PROPERTY_OUTPUT_VOLUME, AUDIO_CHANNEL_ALL, v);
	audio_codec_apply_properties(codec);
}
```

## src/sound.h
```c
/* N900 phone demo: speaker sounds */
#ifndef SOUND_H_
#define SOUND_H_

enum sound_id {
	SOUND_CLICK,
	SOUND_RINGTONE,  /* repeats until sound_stop() */
	SOUND_RINGBACK,  /* repeats until sound_stop() */
	SOUND_CALL_END,
	SOUND_MESSAGE,
	SOUND_SHUTTER,
	SOUND_CHARGER,
	SOUND_STARTUP,
	SOUND_COUNT,
};

void sound_init(void);
/* Replaces whatever is playing */
void sound_play(enum sound_id id);
/* DTMF tone of a dial pad key: 0-9, '*' or '#' */
void sound_dtmf(char key);
void sound_stop(void);
/* 0 mutes, 100 is full scale */
void sound_set_volume(int pct);

#endif
```
