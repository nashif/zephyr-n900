## CMakeLists.txt
```
# SPDX-FileCopyrightText: Copyright (c) 2026 Silicon Laboratories Inc.
# SPDX-License-Identifier: Apache-2.0

cmake_minimum_required(VERSION 3.20.0)
find_package(Zephyr REQUIRED HINTS $ENV{ZEPHYR_BASE})
project(n900_entropy)
target_sources(app PRIVATE src/main.c)
```

## prj.conf
```kconfig
# SPDX-FileCopyrightText: Copyright (c) 2026 Silicon Laboratories Inc.
# SPDX-License-Identifier: Apache-2.0

CONFIG_PRINTK=y
CONFIG_ENTROPY_GENERATOR=y
```

## src/main.c
```c
/*
 * SPDX-FileCopyrightText: Copyright (c) 2026 Silicon Laboratories Inc.
 * SPDX-License-Identifier: Apache-2.0
 */

/*
 * Entropy bring-up: a line of random bytes from the entropy device every
 * second, with the time it took to get them.
 */

#include <zephyr/device.h>
#include <zephyr/drivers/entropy.h>
#include <zephyr/kernel.h>

static const struct device *const entropy = DEVICE_DT_GET(DT_CHOSEN(zephyr_entropy));

int main(void)
{
	uint8_t buf[32];

	printk("N900 entropy: %s\n", device_is_ready(entropy) ? "ready" : "NOT READY");

	while (true) {
		uint32_t start = k_cycle_get_32();
		int ret = entropy_get_entropy(entropy, buf, sizeof(buf));
		uint32_t us = k_cyc_to_us_floor32(k_cycle_get_32() - start);

		if (ret != 0) {
			printk("error %d\n", ret);
		} else {
			for (size_t i = 0; i < sizeof(buf); i++) {
				printk("%02x", buf[i]);
			}
			printk("  %u us\n", us);
		}
		(void)k_msleep(1000);
	}

	return 0;
}
```
