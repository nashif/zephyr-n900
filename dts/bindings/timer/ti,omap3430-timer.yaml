## dts/bindings/timer/ti,omap3430-timer.yaml
```yaml
# Copyright The Zephyr Project Contributors
# SPDX-License-Identifier: Apache-2.0

description: TI OMAP3 general-purpose timer (GPTIMER)

compatible: "ti,omap3430-timer"

include: base.yaml

properties:
  reg:
    required: true

  interrupts:
    required: true

  clock-frequency:
    type: int
    required: true
    description: |
      Frequency of the functional clock the SoC selects for the timer, in
      Hz. GPTIMER1 runs from SYS_CLK, whose rate depends on the board's
      oscillator.
```

## dts/bindings/usb/ti,omap3-musb.yaml
```yaml
# Copyright The Zephyr Project Contributors
# SPDX-License-Identifier: Apache-2.0

description: |
  TI OMAP3 high-speed USB OTG controller (Mentor Graphics MUSB), used as a
  USB device controller with a ULPI PHY. The reset-gpios of the PHY in phys,
  if any, take the PHY out of reset.

compatible: "ti,omap3-musb"

include: usb-ep.yaml

properties:
  reg:
    required: true

  interrupts:
    required: true

  phys:
    type: phandle
    description: ULPI PHY, with the usb-ulpi-phy compatible.
```

## soc/ti/omap3/Kconfig
```kconfig
# Copyright The Zephyr Project Contributors
# SPDX-License-Identifier: Apache-2.0

config SOC_SERIES_OMAP3
	select ARM
	select CPU_CORTEX_A8
	select VFP_DP_D32
	select NEON
	select ARM_CUSTOM_INTERRUPT_CONTROLLER
	select SOC_RESET_HOOK
	select SOC_EARLY_INIT_HOOK
	select SYS_CLOCK_EXISTS

if SOC_SERIES_OMAP3

config SOC_OMAP3_DSS_CONSOLE
	bool "Console on the display"
	default y
	depends on CONSOLE
	depends on $(dt_nodelabel_has_prop,dispc,memory-region)
	depends on !TI_OMAP3_DISPC
	select CHARACTER_FRAMEBUFFER
	help
	  Draw printk() and stdout output on the LCD. The console takes over
	  the graphics layer that the bootloader configured, keeping its
	  timing and resolution, and scans out an RGB16 framebuffer in the
	  memory region of the display controller node. It is not available
	  while the display driver owns the graphics layer.

config SOC_OMAP3_BOOT_STAGES
	bool "Show boot progress on the display"
	select SOC_PREP_HOOK
	help
	  Paint a colored band into the bootloader's framebuffer at each early
	  boot stage, and a solid screen color once the MMU is on, to locate
	  boot failures without a serial port.

endif # SOC_SERIES_OMAP3
```

## soc/ti/omap3/Kconfig.defconfig
```kconfig
# Copyright The Zephyr Project Contributors
# SPDX-License-Identifier: Apache-2.0

if SOC_SERIES_OMAP3

config NUM_IRQS
	default 96

config SYS_CLOCK_HW_CYCLES_PER_SEC
	default $(dt_nodelabel_int_prop,gptimer1,clock-frequency)

endif # SOC_SERIES_OMAP3
```

## soc/ti/omap3/Kconfig.soc
```kconfig
# Copyright The Zephyr Project Contributors
# SPDX-License-Identifier: Apache-2.0

config SOC_FAMILY_TI_OMAP
	bool

config SOC_SERIES_OMAP3
	bool
	select SOC_FAMILY_TI_OMAP

config SOC_OMAP3430
	bool
	select SOC_SERIES_OMAP3

config SOC_FAMILY
	default "ti_omap" if SOC_FAMILY_TI_OMAP

config SOC_SERIES
	default "omap3" if SOC_SERIES_OMAP3

config SOC
	default "omap3430" if SOC_OMAP3430
```

## west.yml
```yaml
# Copyright The Zephyr Project Contributors
# SPDX-License-Identifier: Apache-2.0

manifest:
  remotes:
    - name: nashif
      url-base: https://github.com/nashif

  projects:
    - name: zephyr
      remote: nashif
      # Upstream main plus the core changes the N900 needs
      revision: topic/n900/core
      import:
        name-allowlist:
          - cmsis # Cortex-A core headers
          - lvgl  # the phone demo UI
```
