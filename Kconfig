## Kconfig
```kconfig
# Copyright The Zephyr Project Contributors
# SPDX-License-Identifier: Apache-2.0

rsource "drivers/Kconfig"
```

## apps/bringup/battery/Kconfig
```kconfig
config APP_REBOOT_AFTER_S
	int "Reboot after this many seconds, 0 to run forever"
	default 0

source "Kconfig.zephyr"
```

## boards/nokia/n900/Kconfig
```kconfig
# Copyright The Zephyr Project Contributors
# SPDX-License-Identifier: Apache-2.0

config BOARD_N900
	select BOARD_LATE_INIT_HOOK

if BOARD_N900

config BOARD_N900_CHARGE_TEMP_GUARD
	bool "Charge only within the battery temperature window"
	default y
	depends on CHARGER && FUEL_GAUGE
	help
	  Read the battery temperature from the fuel gauge every 10 s and
	  disable charging outside the configured window, or when the
	  temperature cannot be read.

if BOARD_N900_CHARGE_TEMP_GUARD

config BOARD_N900_CHARGE_TEMP_MIN
	int "Lowest battery temperature for charging, in degrees Celsius"
	default 0

config BOARD_N900_CHARGE_TEMP_MAX
	int "Highest battery temperature for charging, in degrees Celsius"
	default 45

config BOARD_N900_CHARGE_TEMP_HYSTERESIS
	int "Margin inside the window before charging resumes, in degrees Celsius"
	default 3

endif # BOARD_N900_CHARGE_TEMP_GUARD

config BOARD_N900_POWER_KEY_REBOOT
	bool "Reboot when the power button is held"
	default y
	depends on MFD_TWL4030 && REBOOT
	help
	  Restart the phone with sys_reboot() when the power button is held
	  for BOARD_N900_POWER_KEY_REBOOT_HOLD_MS, which returns to NOLO to
	  load the next image. Shorter presses are left to the application.

config BOARD_N900_POWER_KEY_REBOOT_HOLD_MS
	int "Power button hold time before rebooting, in milliseconds"
	default 2000
	depends on BOARD_N900_POWER_KEY_REBOOT

endif # BOARD_N900
```

## boards/nokia/n900/Kconfig.n900
```kconfig
# Copyright The Zephyr Project Contributors
# SPDX-License-Identifier: Apache-2.0

config BOARD_N900
	select SOC_OMAP3430
```

## boards/nokia/n900/board.yml
```yaml
# Copyright The Zephyr Project Contributors
# SPDX-License-Identifier: Apache-2.0

board:
  name: n900
  full_name: N900
  vendor: nokia
  socs:
  - name: omap3430
```

## drivers/Kconfig
```kconfig
# Copyright The Zephyr Project Contributors
# SPDX-License-Identifier: Apache-2.0

menu "Nokia N900 and TI OMAP3 drivers"

if AUDIO_CODEC
rsource "audio/Kconfig.tlv320aic3x"
endif

if CHARGER
rsource "charger/Kconfig.bq2415x"
endif

if DISPLAY
rsource "display/Kconfig.acx565akm"
rsource "display/Kconfig.ti_omap3_dispc"
endif

if FUEL_GAUGE
rsource "fuel_gauge/bq27200/Kconfig"
endif

if GPIO
rsource "gpio/Kconfig.omap3"
rsource "gpio/Kconfig.twl4030"
endif

if HAPTICS
rsource "haptics/ti/Kconfig.twl4030_vibra"
endif

if HWINFO
rsource "hwinfo/Kconfig.ti_omap3"
endif

if I2C
rsource "i2c/Kconfig.omap3"
endif

if I2S
rsource "i2s/Kconfig.ti_omap_mcbsp"
endif

if INPUT
rsource "input/Kconfig.tsc2005"
rsource "input/Kconfig.twl4030_keypad"
rsource "input/Kconfig.twl4030_pwrbutton"
endif

rsource "interrupt_controller/Kconfig.ti_omap"

if LED
rsource "led/Kconfig.adp1653"
rsource "led/Kconfig.lp5523"
endif

if MFD
rsource "mfd/Kconfig.twl4030"
endif

if PINCTRL
rsource "pinctrl/Kconfig.ti_omap3"
endif

if SENSOR
rsource "sensor/st/lis302dl/Kconfig"
endif

rsource "timer/Kconfig.ti_omap_gptimer"

if UDC_DRIVER
rsource "usb/udc/Kconfig.omap3_musb"
endif

endmenu
```

## drivers/audio/Kconfig.tlv320aic3x
```kconfig
# Copyright The Zephyr Project Contributors
# SPDX-License-Identifier: Apache-2.0

config AUDIO_TLV320AIC3X
	bool "TI TLV320AIC3x audio codec"
	default y
	depends on DT_HAS_TI_TLV320AIC3X_ENABLED
	select I2C
	help
	  Enable the driver for the TI TLV320AIC3x stereo audio codecs, such
	  as the AIC33 and AIC34, for playback.
```

## drivers/charger/Kconfig.bq2415x
```kconfig
# Copyright The Zephyr Project Contributors
# SPDX-License-Identifier: Apache-2.0

config CHARGER_BQ2415X
	bool "BQ2415x battery charger"
	default y
	depends on DT_HAS_TI_BQ24150A_ENABLED
	select I2C
	help
	  Enable the I2C driver for the TI BQ24150A battery charger. The driver
	  resets the charger's 32 s safety timer periodically, which keeps the
	  configured charge settings in effect.
```

## drivers/display/Kconfig.acx565akm
```kconfig
# Copyright The Zephyr Project Contributors
# SPDX-License-Identifier: Apache-2.0

config ACX565AKM
	bool "Sony ACX565AKM panel controller"
	default y
	depends on DT_HAS_SONY_ACX565AKM_ENABLED
	select SPI
	help
	  Enable the driver for the command interface of the Sony ACX565AKM
	  LCD panel controller: brightness and display on/off.
```

## drivers/display/Kconfig.ti_omap3_dispc
```kconfig
# Copyright The Zephyr Project Contributors
# SPDX-License-Identifier: Apache-2.0

config TI_OMAP3_DISPC
	bool "TI OMAP3 display controller"
	default y
	depends on DT_HAS_TI_OMAP3_DISPC_ENABLED
	select DISPLAY_FRAMEBUFFER
	help
	  Display driver for the graphics layer of the TI OMAP3 display
	  controller, scanning out a reserved framebuffer in XRGB8888. The
	  panel and LCD output must already be configured by the bootloader.
```

## drivers/entropy/Kconfig.omap3_rom
```kconfig
# SPDX-FileCopyrightText: Copyright (c) 2026 Silicon Laboratories Inc.
# SPDX-License-Identifier: Apache-2.0

config ENTROPY_OMAP3_ROM
	bool "TI OMAP3 secure ROM RNG driver"
	default y
	depends on DT_HAS_NOKIA_N900_ROM_RNG_ENABLED
	depends on SOC_SERIES_OMAP3
	select ENTROPY_HAS_DRIVER
	select CACHE_MANAGEMENT
	help
	  Enable the driver for the hardware random number generator of TI
	  OMAP3 SoCs in high-security devices such as the Nokia N900, where
	  only the secure world has access to the RNG module and random
	  numbers come from a service of the secure ROM code.
```

## drivers/fuel_gauge/bq27200/Kconfig
```kconfig
# Copyright The Zephyr Project Contributors
# SPDX-License-Identifier: Apache-2.0

config BQ27200
	bool "BQ27200 fuel gauge"
	default y
	depends on DT_HAS_TI_BQ27200_ENABLED
	select I2C
	help
	  Enable the I2C driver for the TI BQ27200 battery fuel gauge.
```

## drivers/gpio/Kconfig.omap3
```kconfig
# Copyright The Zephyr Project Contributors
# SPDX-License-Identifier: Apache-2.0

config GPIO_OMAP3
	bool "TI OMAP3 GPIO driver"
	default y
	depends on DT_HAS_TI_OMAP3_GPIO_ENABLED
	help
	  Enable the driver for the GPIO banks of TI OMAP3 SoCs.
```

## drivers/gpio/Kconfig.twl4030
```kconfig
# Copyright The Zephyr Project Contributors
# SPDX-License-Identifier: Apache-2.0

config GPIO_TWL4030
	bool "TI TWL4030 GPIO controller"
	default y
	depends on DT_HAS_TI_TWL4030_GPIO_ENABLED
	depends on MFD_TWL4030
	help
	  Enable the driver for the GPIO controller of the TI TWL4030 and
	  TWL5030 power management chips.

config GPIO_TWL4030_INIT_PRIORITY
	int "TWL4030 GPIO initialization priority"
	default 81
	depends on GPIO_TWL4030
	help
	  Initialization priority of the TWL4030 GPIO controller, after the
	  parent TWL4030 device.
```

## drivers/haptics/ti/Kconfig.twl4030_vibra
```kconfig
# Copyright The Zephyr Project Contributors
# SPDX-License-Identifier: Apache-2.0

config HAPTICS_TWL4030_VIBRA
	bool "TI TWL4030 vibrator"
	default y
	depends on DT_HAS_TI_TWL4030_VIBRA_ENABLED
	depends on MFD_TWL4030
	help
	  Enable the driver for the vibrator output of the TI TWL4030 and
	  TWL5030 power management chips.
```

## drivers/hwinfo/Kconfig.ti_omap3
```kconfig
# Copyright The Zephyr Project Contributors
# SPDX-License-Identifier: Apache-2.0

config HWINFO_TI_OMAP3
	bool "TI OMAP3 hwinfo driver"
	default y
	depends on SOC_SERIES_OMAP3
	select HWINFO_HAS_DRIVER
	help
	  Enable the TI OMAP3 hwinfo driver: the die ID as device ID and the
	  reset cause from the power and reset manager.
```

## drivers/i2c/Kconfig.omap3
```kconfig
# Copyright The Zephyr Project Contributors
# SPDX-License-Identifier: Apache-2.0

config I2C_OMAP3
	bool "TI OMAP3 I2C driver"
	default y
	depends on DT_HAS_TI_OMAP3_I2C_ENABLED
	help
	  Polled I2C controller driver for TI OMAP3 SoCs.
```

## drivers/i2s/Kconfig.ti_omap_mcbsp
```kconfig
# Copyright The Zephyr Project Contributors
# SPDX-License-Identifier: Apache-2.0

config I2S_OMAP_MCBSP
	bool "TI OMAP3 McBSP I2S driver"
	default y
	depends on DT_HAS_TI_OMAP3_MCBSP_ENABLED
	select PINCTRL if $(dt_compat_any_has_prop,$(DT_COMPAT_TI_OMAP3_MCBSP),pinctrl-0)
	help
	  Enable the I2S driver for the McBSP serial ports of TI OMAP3 SoCs.
	  The ports transmit in PCM format with the bit and frame clocks from
	  the codec.

config I2S_OMAP_MCBSP_TX_BLOCK_COUNT
	int "TX queue length"
	default 4
	depends on I2S_OMAP_MCBSP
	help
	  Number of memory blocks the transmit queue holds.
```

## drivers/input/Kconfig.tsc2005
```kconfig
# Copyright The Zephyr Project Contributors
# SPDX-License-Identifier: Apache-2.0

config INPUT_TSC2005
	bool "TI TSC2005 touchscreen controller driver"
	default y
	depends on DT_HAS_TI_TSC2005_ENABLED
	select SPI
	select GPIO
	select INPUT_TOUCH
	help
	  Enable the driver for the TI TSC2005 resistive touchscreen
	  controller.
```

## drivers/input/Kconfig.twl4030_keypad
```kconfig
# Copyright The Zephyr Project Contributors
# SPDX-License-Identifier: Apache-2.0

config INPUT_TWL4030_KEYPAD
	bool "TI TWL4030 keypad"
	default y
	depends on DT_HAS_TI_TWL4030_KEYPAD_ENABLED
	depends on MFD_TWL4030
	help
	  Enable the driver for the keypad module of the TI TWL4030 and
	  TWL5030 power management chips.
```

## drivers/input/Kconfig.twl4030_pwrbutton
```kconfig
# Copyright The Zephyr Project Contributors
# SPDX-License-Identifier: Apache-2.0

config INPUT_TWL4030_PWRBUTTON
	bool "TI TWL4030 power button"
	default y
	depends on DT_HAS_TI_TWL4030_PWRBUTTON_ENABLED
	depends on MFD_TWL4030
	help
	  Enable the driver for the power button of the TI TWL4030 and TWL5030
	  power management chips, reported as INPUT_KEY_POWER.
```

## drivers/interrupt_controller/Kconfig.ti_omap
```kconfig
# Copyright The Zephyr Project Contributors
# SPDX-License-Identifier: Apache-2.0

config TI_OMAP_INTC
	bool "TI OMAP3 interrupt controller"
	default y
	depends on DT_HAS_TI_OMAP3_INTC_ENABLED
	depends on ARM_CUSTOM_INTERRUPT_CONTROLLER
	help
	  Interrupt controller (INTCPS) of TI OMAP3 and AM335x SoCs, used as
	  the custom interrupt controller of their Cortex-A8 core.
```

## drivers/led/Kconfig.adp1653
```kconfig
# Copyright The Zephyr Project Contributors
# SPDX-License-Identifier: Apache-2.0

config ADP1653
	bool "ADP1653 camera flash LED driver"
	default y
	depends on DT_HAS_ADI_ADP1653_ENABLED
	select I2C
	select GPIO if $(dt_compat_any_has_prop,$(DT_COMPAT_ADI_ADP1653),enable-gpios)
	help
	  Enable the driver for the Analog Devices ADP1653 camera flash LED
	  driver: torch, indicator and flash through the LED API.
```

## drivers/led/Kconfig.lp5523
```kconfig
# Copyright The Zephyr Project Contributors
# SPDX-License-Identifier: Apache-2.0

config LP5523
	bool "LP5523 LED driver"
	default y
	depends on DT_HAS_NATIONAL_LP5523_ENABLED
	select I2C
	select GPIO if $(dt_compat_any_has_prop,$(DT_COMPAT_NATIONAL_LP5523),enable-gpios)
	help
	  Enable the driver for the TI (National Semiconductor) LP5523
	  9-channel I2C LED driver.
```
