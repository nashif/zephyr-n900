## drivers/mfd/Kconfig.twl4030
```kconfig
# Copyright The Zephyr Project Contributors
# SPDX-License-Identifier: Apache-2.0

config MFD_TWL4030
	bool "TI TWL4030 power management chip"
	default y
	depends on DT_HAS_TI_TWL4030_ENABLED
	select I2C
	help
	  Enable the driver for the TI TWL4030 and TWL5030 power management
	  chips: register access for the drivers of their modules and the
	  dispatch of the chip's interrupt line.
```

## drivers/pinctrl/Kconfig.ti_omap3
```kconfig
# Copyright The Zephyr Project Contributors
# SPDX-License-Identifier: Apache-2.0

config PINCTRL_TI_OMAP3
	bool "TI OMAP3 pinctrl driver"
	default y
	depends on DT_HAS_TI_OMAP3_PINCTRL_ENABLED
	help
	  Enable the pad configuration driver of the TI OMAP3 system control
	  module.
```

## drivers/sensor/st/lis302dl/Kconfig
```kconfig
# Copyright The Zephyr Project Contributors
# SPDX-License-Identifier: Apache-2.0

config LIS302DL
	bool "LIS302DL accelerometer"
	default y
	depends on DT_HAS_ST_LIS302DL_ENABLED
	select I2C
	help
	  Enable the driver for the ST LIS302DL I2C 3-axis accelerometer.

config LIS302DL_TRIGGER
	bool "LIS302DL data ready and tap triggers"
	default y
	depends on LIS302DL
	depends on $(dt_compat_any_has_prop,$(DT_COMPAT_ST_LIS302DL),irq-gpios)
	select GPIO
	help
	  Report data ready on the INT1 line and single clicks on the INT2
	  line of the irq-gpios property. The handlers run in the system
	  work queue.
```

## drivers/timer/Kconfig.ti_omap_gptimer
```kconfig
# Copyright The Zephyr Project Contributors
# SPDX-License-Identifier: Apache-2.0

config TI_OMAP_GPTIMER
	bool "TI OMAP3 general-purpose timer"
	default y
	depends on DT_HAS_TI_OMAP3430_TIMER_ENABLED
	select TICKLESS_CAPABLE
	help
	  System timer driver for the general-purpose timers (GPTIMER) of TI
	  OMAP3 SoCs.
```

## drivers/usb/udc/Kconfig.omap3_musb
```kconfig
# Copyright The Zephyr Project Contributors
# SPDX-License-Identifier: Apache-2.0

config UDC_OMAP3_MUSB
	bool "TI OMAP3 MUSB USB device controller driver"
	default y
	depends on DT_HAS_TI_OMAP3_MUSB_ENABLED
	select EVENTS
	select UDC_DRIVER_HAS_HIGH_SPEED_SUPPORT
	select GPIO if $(dt_compat_any_has_prop,$(DT_COMPAT_USB_ULPI_PHY),reset-gpios)
	help
	  Enable the driver for the high-speed USB OTG controller of the TI
	  OMAP3 SoCs, in peripheral mode.

if UDC_OMAP3_MUSB

config UDC_OMAP3_MUSB_STACK_SIZE
	int "Driver thread stack size"
	default 1024
	help
	  Size of the stack of the driver thread.

config UDC_OMAP3_MUSB_THREAD_PRIORITY
	int "Driver thread priority"
	default 8
	help
	  Cooperative priority of the driver thread.

endif # UDC_OMAP3_MUSB
```

## dts/bindings/audio/ti,tlv320aic3x.yaml
```yaml
# Copyright The Zephyr Project Contributors
# SPDX-License-Identifier: Apache-2.0

description: |
  TI TLV320AIC3x stereo audio codec, such as the AIC33 or one half of the
  AIC34, on I2C. The PLL derives the codec clock from MCLK.

compatible: "ti,tlv320aic3x"

include: i2c-device.yaml

properties:
  reset-gpios:
    type: phandle-array
    description: Reset line of the codec.

  hp-out:
    type: boolean
    description: |
      Play through the high-power outputs: HPLOUT and HPROUT, with HPLCOM
      and HPRCOM driven as their inverse for bridge-tied loads.

  line-out:
    type: boolean
    description: Play through the line outputs LEFT_LOP/M and RIGHT_LOP/M.
```

## dts/bindings/charger/ti,bq24150a.yaml
```yaml
# Copyright The Zephyr Project Contributors
# SPDX-License-Identifier: Apache-2.0

description: |
  TI BQ24150A I2C-controlled single-cell Li-ion battery charger.

  The charge and termination currents are set through the external sense
  resistor; the driver rounds each requested value down to a step the
  charger implements.

include: [battery.yaml, i2c-device.yaml]

compatible: "ti,bq24150a"

properties:
  constant-charge-current-max-microamp:
    required: true

  constant-charge-voltage-max-microvolt:
    required: true
    description: Battery regulation voltage, 3.5 V to 4.44 V in 20 mV steps.

  charge-term-current-microamp:
    required: true

  input-current-limit-microamp:
    type: int
    default: 100000
    description: |
      Input current limit: 100 mA, 500 mA, 800 mA, or no limit above 800 mA.

  ti,weak-battery-microvolt:
    type: int
    default: 3400000
    description: Weak battery threshold, 3.4 V to 3.7 V in 100 mV steps.

  ti,sense-resistor-micro-ohms:
    type: int
    required: true
    description: Value of the charge current sense resistor.
```

## dts/bindings/display/sony,acx565akm.yaml
```yaml
# Copyright The Zephyr Project Contributors
# SPDX-License-Identifier: Apache-2.0

description: |
  Sony ACX565AKM LCD panel controller

  Command interface on 3-wire SPI with 9-bit words. The pixels come from a
  display controller over a separate video link; point that controller's
  display-controller property at this node to control the brightness.

compatible: "sony,acx565akm"

include: spi-device.yaml
```

## dts/bindings/display/ti,omap3-dispc.yaml
```yaml
# Copyright The Zephyr Project Contributors
# SPDX-License-Identifier: Apache-2.0

description: |
  TI OMAP3 display controller (DISPC).

  The bootloader configures the panel and the LCD output; the graphics
  layer scans out the framebuffer in the memory-region node.

compatible: "ti,omap3-dispc"

include: display-controller.yaml

properties:
  reg:
    required: true

  memory-region:
    type: phandle
    required: true
    description: |
      Memory reserved for the framebuffer of the graphics layer, outside
      the RAM given to Zephyr.

  display-controller:
    type: phandle
    description: |
      Panel controller that the brightness requests are forwarded to.
```

## dts/bindings/fuel-gauge/ti,bq27200.yaml
```yaml
# Copyright The Zephyr Project Contributors
# SPDX-License-Identifier: Apache-2.0

description: TI BQ27200 single-cell battery fuel gauge

compatible: "ti,bq27200"

include: [i2c-device.yaml, fuel-gauge.yaml]

properties:
  ti,sense-resistor-micro-ohms:
    type: int
    default: 20000
    description: |
      Value of the current sense resistor, from which the gauge's current
      and capacity readings are scaled.
```

## dts/bindings/gpio/ti,omap3-gpio.yaml
```yaml
# Copyright The Zephyr Project Contributors
# SPDX-License-Identifier: Apache-2.0

description: |
  GPIO bank of TI OMAP3 SoCs, 32 pins. Pull resistors are part of the pad
  configuration.

compatible: "ti,omap3-gpio"

include: [gpio-controller.yaml, base.yaml]

properties:
  reg:
    required: true

  interrupts:
    required: true

  "#gpio-cells":
    const: 2

gpio-cells:
  - pin
  - flags
```

## dts/bindings/gpio/ti,twl4030-gpio.yaml
```yaml
# Copyright The Zephyr Project Contributors
# SPDX-License-Identifier: Apache-2.0

description: |
  GPIO controller of the TI TWL4030 and TWL5030 power management chips, a
  child of the chip's ti,twl4030 node.

compatible: "ti,twl4030-gpio"

include: gpio-controller.yaml

properties:
  "#gpio-cells":
    const: 2

gpio-cells:
  - pin
  - flags
```

## dts/bindings/haptics/ti,twl4030-vibra.yaml
```yaml
# Copyright The Zephyr Project Contributors
# SPDX-License-Identifier: Apache-2.0

description: |
  Vibrator output of the TI TWL4030 and TWL5030 power management chips, a
  child of the chip's ti,twl4030 node. The audio block's PWM drives the
  motor at a fixed duty cycle.

compatible: "ti,twl4030-vibra"

include: base.yaml

properties:
  duty-cycle-percent:
    type: int
    default: 100
    description: |
      Duty cycle of the motor drive in percent, 1 to 100. The default drives
      the motor at full strength.
```

## dts/bindings/i2c/ti,omap3-i2c.yaml
```yaml
# Copyright The Zephyr Project Contributors
# SPDX-License-Identifier: Apache-2.0

description: TI OMAP3 I2C controller

compatible: "ti,omap3-i2c"

include: i2c-controller.yaml

properties:
  reg:
    required: true

  interrupts:
    required: true
```

## dts/bindings/i2s/ti,omap3-mcbsp.yaml
```yaml
# Copyright The Zephyr Project Contributors
# SPDX-License-Identifier: Apache-2.0

description: |
  TI OMAP3 McBSP (multichannel buffered serial port) used as an I2S
  transmitter. The port takes its bit and frame clocks from the codec.

compatible: "ti,omap3-mcbsp"

include: [i2s-controller.yaml, pinctrl-device.yaml]

properties:
  reg:
    required: true

  interrupts:
    required: true
    description: The port's common interrupt.
```

## dts/bindings/input/ti,tsc2005.yaml
```yaml
# Copyright The Zephyr Project Contributors
# SPDX-License-Identifier: Apache-2.0

description: |
  TI TSC2005 resistive touchscreen controller

  Raw samples between min-x and max-x, and min-y and max-y, are scaled to
  screen-width and screen-height, which are required.

compatible: "ti,tsc2005"

include: [spi-device.yaml, touchscreen-common.yaml]

properties:
  int-gpios:
    type: phandle-array
    required: true
    description: |
      PINTDAV output, active when a set of samples is available.

  reset-gpios:
    type: phandle-array
    description: |
      RESET input. The chip is held in reset while the line is active.

  ti,x-plate-ohms:
    type: int
    default: 280
    description: Resistance of the X plate, in ohms, used for the touch pressure.

  min-x:
    type: int
    default: 0
    description: Raw X sample at the left edge of the screen.

  max-x:
    type: int
    default: 4095
    description: Raw X sample at the right edge of the screen.

  min-y:
    type: int
    default: 0
    description: Raw Y sample at the top edge of the screen.

  max-y:
    type: int
    default: 4095
    description: Raw Y sample at the bottom edge of the screen.

  max-pressure:
    type: int
    default: 2048
    description: Samples with a higher touch resistance are discarded.
```

## dts/bindings/input/ti,twl4030-keypad.yaml
```yaml
# Copyright The Zephyr Project Contributors
# SPDX-License-Identifier: Apache-2.0

description: |
  Keypad module of the TI TWL4030 and TWL5030 power management chips, a
  child of the chip's ti,twl4030 node.

  The driver reports row and column events; an input-keymap child node maps
  them to key codes. A row whose inputs all read pressed is reported as one
  extra column, col-size. Key changes are read on the chip's interrupt, or
  polled when the parent has no interrupt.

compatible: "ti,twl4030-keypad"

include: base.yaml

properties:
  row-size:
    type: int
    required: true
    description: Number of matrix rows, up to 8.

  col-size:
    type: int
    required: true
    description: Number of matrix columns, up to 8.

  poll-period-ms:
    type: int
    default: 20
    description: Interval between reads of the matrix state when polled.
```

## dts/bindings/input/ti,twl4030-pwrbutton.yaml
```yaml
# Copyright The Zephyr Project Contributors
# SPDX-License-Identifier: Apache-2.0

description: |
  Power button of the TI TWL4030 and TWL5030 power management chips, a
  child of the chip's ti,twl4030 node. It reports INPUT_KEY_POWER.

compatible: "ti,twl4030-pwrbutton"

include: base.yaml
```

## dts/bindings/interrupt-controller/ti,omap3-intc.yaml
```yaml
# Copyright The Zephyr Project Contributors
# SPDX-License-Identifier: Apache-2.0

description: TI OMAP3 interrupt controller (INTCPS)

compatible: "ti,omap3-intc"

include: [interrupt-controller.yaml, base.yaml]

properties:
  reg:
    required: true

  ti,intc-size:
    type: int
    required: true
    description: Number of interrupt inputs.

  "#interrupt-cells":
    const: 2

interrupt-cells:
  - irq
  - priority
```

## dts/bindings/led/adi,adp1653.yaml
```yaml
# Copyright The Zephyr Project Contributors
# SPDX-License-Identifier: Apache-2.0

description: |
  Analog Devices ADP1653 camera flash LED driver

  LED 0 of the LED API is the high-power LED in torch mode and LED 1 the
  indicator LED. Setting LED 2 to any non-zero brightness fires one flash of
  the high-power LED at flash-max-microamp, which the chip ends after
  flash-timeout-us; LEDs 0 and 1 return -EBUSY until then.

compatible: "adi,adp1653"

include: i2c-device.yaml

properties:
  enable-gpios:
    type: phandle-array
    description: GPIO driving the EN pin. The chip is enabled while the line is active.

  torch-max-microamp:
    type: int
    required: true
    description: |
      High-power LED current at full torch brightness, in microamperes, from
      50000 to 200000 in steps of 15000.

  flash-max-microamp:
    type: int
    required: true
    description: |
      High-power LED current of a flash, in microamperes, from 50000 to 500000
      in steps of 15000.

  flash-timeout-us:
    type: int
    default: 500000
    description: |
      Flash duration in microseconds, at most 820000, rounded down to a step of
      54600.

  indicator-max-microamp:
    type: int
    default: 0
    description: |
      Indicator LED current at full brightness, in microamperes, up to 17500
      in steps of 2500. The default leaves the indicator off.
```

## dts/bindings/led/national,lp5523.yaml
```yaml
# Copyright The Zephyr Project Contributors
# SPDX-License-Identifier: Apache-2.0

description: |
  TI (National Semiconductor) LP5523 9-channel LED driver

  Channels 0 to 8 are LEDs 0 to 8 of the LED API.

compatible: "national,lp5523"

include: i2c-device.yaml

properties:
  enable-gpios:
    type: phandle-array
    description: |
      GPIO driving the EN pin. The chip is enabled while the line is active.

  current-microamp:
    type: int
    default: 17500
    description: |
      Output current of every channel at full brightness, in microamperes,
      in steps of 100 uA up to 25500. The default is the reset value.
```

## dts/bindings/mfd/ti,twl4030.yaml
```yaml
# Copyright The Zephyr Project Contributors
# SPDX-License-Identifier: Apache-2.0

description: |
  TI TWL4030 and TWL5030 power management chips. The node's address is the
  first of the four consecutive I2C addresses the chip answers at, and its
  interrupt is the chip's INT1 line.

compatible: "ti,twl4030"

include: i2c-device.yaml
```

## dts/bindings/pinctrl/ti,omap3-pinctrl.yaml
```yaml
# Copyright The Zephyr Project Contributors
# SPDX-License-Identifier: Apache-2.0

description: |
  TI OMAP3 pad configuration

  Each pad has a 16-bit configuration register in the system control module.
  Each child node configures one pad with OMAP3_PINMUX(pad, value, mux_mode) from
  <zephyr/dt-bindings/pinctrl/ti-omap3-pinctrl.h>:

  pad - the address of the pad configuration register, less the system control
        module base (0x48002000), as listed in the TRM; for example 0x21c8 for
        mcspi1_clk. The macro converts it to an offset from the node address.
  value - PIN_OUTPUT, PIN_OUTPUT_PULLUP, PIN_OUTPUT_PULLDOWN, PIN_INPUT,
          PIN_INPUT_PULLUP or PIN_INPUT_PULLDOWN.
  mux_mode - MUX_MODE_0 to MUX_MODE_7.

  For example:

    mcspi1_clk_default: mcspi1_clk_default {
      pinmux = <OMAP3_PINMUX(0x21c8, PIN_INPUT, MUX_MODE_0)>;
    };

compatible: "ti,omap3-pinctrl"

include: base.yaml

properties:
  reg:
    required: true

child-binding:
  description: OMAP3 pad configuration

  properties:
    pinmux:
      required: true
      type: array
      description: |
        Pad register offset and configuration value, built with
        OMAP3_PINMUX().
```

## dts/bindings/rng/nokia,n900-rom-rng.yaml
```yaml
# SPDX-FileCopyrightText: Copyright (c) 2026 Silicon Laboratories Inc.
# SPDX-License-Identifier: Apache-2.0

description: |
  Hardware random number generator of the TI OMAP3 in the Nokia N900. The
  N900 is a high-security device: only the secure world has access to the
  RNG module, and random numbers come from a service of the secure ROM code.

compatible: "nokia,n900-rom-rng"

include: base.yaml
```
